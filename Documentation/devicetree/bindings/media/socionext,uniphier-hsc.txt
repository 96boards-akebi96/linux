## Documentation/devicetree/bindings/media/socionext,uniphier-hsc.txt
```
Socionext UniPhier HSC (High-speed Stream Controller)

The Socionext UniPhier HSC subsystem consists of MPEG2-TS input/output and
demultiplexer cores in the same register space.

This interface supports TS serial signals (clock, valid, sync, data) from
external demodulators.

Required properties:
- compatible      : should be one of the following:
		    "socionext,uniphier-ld11-hsc"
		    "socionext,uniphier-ld20-hsc"
- reg             : offset and length of the register set for the device.
- interrupts      : should contain DMA and TSI error interrupt.
- pinctrl-names   : should be "default".
- pinctrl-0       : defined TS serial signal pins for external demodulators.
- clock-names     : should include the following entries:
                    "hsc", "stdmac"
- clocks          : a list of phandle, should contain an entry for each
                    entry in clock-names.
- reset-names     : should include the following entries:
                    "hsc", "stdmac"
- resets          : a list of phandle, should contain an entry for each
                    entry in reset-names.

Example:
	hsc {
		compatible = "socionext,uniphier-ld20-hsc";
		reg = <0x5c000000 0x100000>;
		interrupts = <0 100 4>, <0 101 4>;
		pinctrl-names = "default";
		pinctrl-0 = <&pinctrl_hscin2_s>,
			    <&pinctrl_hscin3_s>;
		clock-names = "stdmac", "hsc";
		clocks = <&sys_clk 8>, <&sys_clk 9>;
		reset-names = "stdmac", "hsc";
		resets = <&sys_rst 8>, <&sys_rst 9>;
	};
```

## Documentation/devicetree/bindings/phy/uniphier-ahci-phy.txt
```
Socionext UniPhier AHCI PHY

This describes the deivcetree bindings for PHY interfaces built into
AHCI glue layer implemented on Socionext UniPhier SoCs.

Required properties:
- compatible: Should contain one of the following:
    "socionext,uniphier-pxs2-ahci-phy" - for PXs2 SoC
    "socionext,uniphier-pxs3-ahci-phy" - for PXs3 SoC
- reg: Specifies offset and length of the register set for the device.
- #phy-cells: Must be zero.
- clocks: A list of phandles to the clock gate for AHCI glue layer.
	According to the clock-names, appropriate clocks are required.
- clock-names:
	"link"        - for PXs2 SoC
	"phy", "link" - for PXs3 SoC
- resets: A list of phandles for the reset control for AHCI glue layer.
	According to the reset-names, appropriate resets are required.
- reset-names:
	"phy", "link" - for PXs2 and PXs3 SoCs

Refer to phy/phy-bindings.txt for the generic PHY binding properties.

Example:

	ahci-glue@65700000 {
		compatible = "socionext,uniphier-pxs3-ahci-glue",
			     "simple-mfd";
		#address-cells = <1>;
		#size-cells = <1>;
		ranges = <0 0x65700000 0x100>;

		ahci_phy: phy@10 {
			compatible = "socionext,uniphier-pxs3-ahci-phy";
			reg = <0x10 0x10>;
			clock-names = "link", "phy";
			clocks = <&sys_clk 28>, <&sys_clk 30>;
			reset-names = "link", "phy";
			resets = <&sys_rst 28>, <&sys_rst 30>;
			#phy-cells = <0>;
		};
		...
	};
```

## drivers/media/platform/uniphier/Kconfig
```kconfig
# SPDX-License-Identifier: GPL-2.0
config DVB_UNIPHIER
	tristate "Socionext UniPhier Frontend"
	depends on DVB_CORE && OF
	depends on ARCH_UNIPHIER || COMPILE_TEST
	select FW_LOADER
	select REGMAP_MMIO
	help
	  Driver for UniPhier frontend for MPEG2-TS input/output,
	  demux and descramble.
	  Say Y when you want to support this frontend.

config DVB_UNIPHIER_LD11
	bool "Support UniPhier LD11/LD20 HSC Device Driver"
	depends on DVB_UNIPHIER
	help
	  Driver for the HSC (High speed Stream Controller) for
	  UniPhier LD11/LD20.
	  Say Y when you want to support this hardware.

config DVB_UNIPHIER_LD11_ISDB
	tristate "Support UniPhier LD11 ISDB adapters"
	depends on DVB_UNIPHIER
	select DVB_MN88443X if MEDIA_SUBDRV_AUTOSELECT
	select DVB_HELENE if MEDIA_SUBDRV_AUTOSELECT
	help
	  Driver for LD11 ISDB-S/T adapters which use
	  Demux: Socionext LD11 HSC
	  Demod: Socionext MN884433
	  Tuner: SONY HELENE (CXD2858ER)
	  Say Y when you want to support this adapters.

config DVB_UNIPHIER_LD20_ISDB
	tristate "Support UniPhier LD20 ISDB adapters"
	depends on DVB_UNIPHIER
	select DVB_MN88443X if MEDIA_SUBDRV_AUTOSELECT
	select DVB_HELENE if MEDIA_SUBDRV_AUTOSELECT
	help
	  Driver for LD20 ISDB-S/T adapters which use
	  Demux: Socionext LD20 HSC
	  Demod: Socionext MN884434
	  Tuner: SONY HELENE (CXD2858ER)
	  Say Y when you want to support this adapters.
```

## drivers/phy/socionext/Kconfig
```kconfig
#
# PHY drivers for Socionext platforms.
#

config PHY_UNIPHIER_PCIE
	tristate "Uniphier PHY driver for PCIe controller"
	depends on ARCH_UNIPHIER || COMPILE_TEST
	depends on OF && HAS_IOMEM
	default PCIE_UNIPHIER
	select GENERIC_PHY
	help
	  Enable this to support PHY implemented in PCIe controller
	  on UniPhier SoCs. This driver supports LD20 and PXs3 SoCs.

config PHY_UNIPHIER_AHCI
	tristate "UniPhier AHCI PHY driver"
	depends on ARCH_UNIPHIER || COMPILE_TEST
	depends on OF && HAS_IOMEM
	default SATA_AHCI_PLATFORM
	select GENERIC_PHY
	help
	  Enable this to support PHY implemented in AHCI controller
	  on UniPhier SoCs.
```

## drivers/reset/Kconfig
```kconfig
config ARCH_HAS_RESET_CONTROLLER
	bool

menuconfig RESET_CONTROLLER
	bool "Reset Controller Support"
	default y if ARCH_HAS_RESET_CONTROLLER
	help
	  Generic Reset Controller support.

	  This framework is designed to abstract reset handling of devices
	  via GPIOs or SoC-internal reset controller modules.

	  If unsure, say no.

if RESET_CONTROLLER

config RESET_SIMPLE
	bool "Simple Reset Controller Driver" if COMPILE_TEST
	default ARCH_SUNXI
	help
	  This enables a simple reset controller driver for reset lines that
	  that can be asserted and deasserted by toggling bits in a contiguous,
	  exclusive register space.

	  Currently this driver supports Allwinner SoCs.

config RESET_UNIPHIER_GLUE
	tristate "Reset driver in glue layer for UniPhier SoCs"
 	depends on (ARCH_UNIPHIER || COMPILE_TEST) && OF
 	default ARCH_UNIPHIER
 	select RESET_SIMPLE
 	help
	  Support for peripheral core reset included in its own glue layer
	  on UniPhier SoCs. Say Y if you want to control reset signals
	  provided by the glue layer.

endif

source "drivers/reset/sti/Kconfig"
```

## drivers/soc/uniphier/Kconfig
```kconfig
menuconfig UNIPHIER_DRIVERS
	bool "Socionext UniPhier vendor-specific drivers"
	depends on ARCH_UNIPHIER
	default n
	---help---
	  Provide vendor-specific drivers for Socionext UniPhier series.
```
