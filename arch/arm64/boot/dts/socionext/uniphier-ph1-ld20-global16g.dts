// SPDX-License-Identifier: GPL-2.0+ OR MIT
//
// Device Tree Source for UniPhier PH1-LD20 Global Board w/16GB RAM
//
// Copyright (C) 2017 Socionext Inc.

#include "uniphier-ph1-ld20-global.dts"

/ {
	compatible = "socionext,ph1-ld20-global16g", "socionext,ph1-ld20";
	memory {
		reg = <0 0x80000000 0 0x80000000>;
	};
};
