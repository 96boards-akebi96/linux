// SPDX-License-Identifier: GPL-2.0+ OR MIT
//
// Device Tree Source for UniPhier PH1-LD20 Global Board v4
//
// Copyright (C) 2017 Socionext Inc.

#include "uniphier-ph1-ld20-global.dts"

/ {
	model = "UniPhier PH1-LD20 Global Board v4(REF_LD20_GP_V4)";
	compatible = "socionext,ph1-ld20-global-v4", "socionext,ph1-ld20";

	memory {
		reg = <0 0x80000000 0 0x20000000>, <0 0xc0000000 0 0x40000000>;
	};

	audio_codec1: bd28623 {
		compatible = "rohm,bd28623";
		reset-gpios = <&gpio UNIPHIER_GPIO_PORT(0, 0) GPIO_ACTIVE_LOW>;
		mute-gpios = <&gpio UNIPHIER_GPIO_PORT(0, 1) GPIO_ACTIVE_LOW>;
		#sound-dai-cells = <0>;
	};
};

&sound_codec_sp {
	sound-dai = <&audio_codec1>;
};
